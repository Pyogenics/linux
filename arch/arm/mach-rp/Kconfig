## arch/arm/mach-rp/Kconfig
```kconfig
# SPDX-License-Identifier: GPL-2.0
menuconfig ARCH_RP
	bool "Raspberry Pi microcontroller support"
	depends on ARM_SINGLE_ARMV7M
	help
	  This enables support for Raspberry Pi rp series microcontrollers.

if ARCH_RP

if ARM_SINGLE_ARMV7M

config ARCH_RP2040
	bool "Raspberry Pi rp2040 microcontroller support"
	depends on XIP_KERNEL && !MMU
	help
	  Enable support for the rp2040 micrcontroller.

endif

endif
```
